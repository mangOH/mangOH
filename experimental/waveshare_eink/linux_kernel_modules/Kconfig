## experimental/waveshare_eink/linux_kernel_modules/Kconfig
```kconfig
#
# FBWS IMU driver
#

config FBWS
	tristate
	depends on FB
	select FB_SYS_IMAGEBLIT
	select FB_DEFERRED_IO



config RPIFB
	tristate "Bosch FBWS SPI driver"
	depends on SPI
	select FBWS
	select REGMAP_SPI
	help
	  If you say yes here you get support for BMI160 IMU on SPI with
	  accelerometer, gyroscope and external BMG160 magnetometer.

	  This driver can also be built as a module. If so, the module will be
	  called bmi160_spi.
```

## linux_kernel_modules/bmm150/Kconfig
```kconfig
config BMC150_MAGN
	tristate
	select IIO_BUFFER
	select IIO_TRIGGERED_BUFFER

config BMC150_MAGN_I2C
	tristate "Bosch BMC150 I2C Magnetometer Driver"
	depends on I2C
	select BMC150_MAGN
	select REGMAP_I2C
	help
	  Say yes here to build support for the BMC150 magnetometer with
	  I2C interface.

	  This is a combo module with both accelerometer and magnetometer.
	  This driver is only implementing magnetometer part, which has
	  its own address and register map.

	  This driver also supports I2C Bosch BMC156 and BMM150 chips.
	  To compile this driver as a module, choose M here: the module will be
	  called bmc150_magn_i2c.
```

## linux_kernel_modules/bmp280/Kconfig
```kconfig
#
# Pressure drivers
#
# When adding new entries keep the list in alphabetical order

menu "BMP 280 Pressure sensor"

config BMP280
	tristate "Bosch Sensortec BMP180/BMP280 pressure sensor I2C driver"
	depends on (I2C || SPI_MASTER)
	select REGMAP
	select BMP280_I2C if (I2C)
	select BMP280_SPI if (SPI_MASTER)
	help
	  Say yes here to build support for Bosch Sensortec BMP180 and BMP280
	  pressure and temperature sensors. Also supports the BE280 with
	  an additional humidity sensor channel.

	  To compile this driver as a module, choose M here: the core module
	  will be called bmp280 and you will also get bmp280-i2c for I2C
	  and/or bmp280-spi for SPI support.

config BMP280_I2C
	tristate
	depends on BMP280
	depends on I2C
	select REGMAP_I2C

config BMP280_SPI
	tristate
	depends on BMP280
	depends on SPI_MASTER
	select REGMAP

endmenu
```

## linux_kernel_modules/bq25601/Kconfig
```kconfig
menuconfig POWER_SUPPLY
	bool "Power supply class support"
	help
	  Say Y here to enable power supply class support. This allows
	  power supply (batteries, AC, USB) monitoring by userspace
	  via sysfs and uevent (if available) and/or APM kernel interface
	  (if selected below).

if POWER_SUPPLY


config CHARGER_BQ25601
	tristate "TI BQ25601 battery charger driver"
	depends on I2C && GPIOLIB
	help
	  Say Y to enable support for the TI BQ25601 battery charger.


endif # POWER_SUPPLY
```

## linux_kernel_modules/bq27xxx/Kconfig
```kconfig
if POWER_SUPPLY

config BATTERY_BQ27XXX
	tristate "BQ27xxx battery driver"
	help
	  Say Y here to enable support for batteries with BQ27xxx chips.

config BATTERY_BQ27XXX_I2C
	tristate "BQ27xxx I2C support"
	depends on BATTERY_BQ27XXX
	depends on I2C
	default y
	help
	  Say Y here to enable support for batteries with BQ27xxx chips
	  connected over an I2C bus.

endif # POWER_SUPPLY
```

## linux_kernel_modules/ltc294x/Kconfig
```kconfig
menuconfig POWER_SUPPLY
	bool "Power supply class support"
	help
	  Say Y here to enable power supply class support. This allows
	  power supply (batteries, AC, USB) monitoring by userspace
	  via sysfs and uevent (if available) and/or APM kernel interface
	  (if selected below).

if POWER_SUPPLY


config BATTERY_GAUGE_LTC2941
	tristate "LTC2941/LTC2943 Battery Gauge Driver"
	depends on I2C
	help
	  Say Y here to include support for LTC2941 and LTC2943 Battery
	  Gauge IC. The driver reports the charge count continuously, and
	  measures the voltage and temperature every 10 seconds.

endif # POWER_SUPPLY
```

## linux_kernel_modules/opt300x/Kconfig
```kconfig
#
# Light sensors
#
# When adding new entries keep the list in alphabetical order

menu "Light sensors"

config OPT3001
	tristate "Texas Instruments OPT3001 Light Sensor"
	depends on I2C
	help
	  If you say Y or M here, you get support for Texas Instruments
	  OPT3001 Ambient Light Sensor.

	  If built as a dynamically linked module, it will be called
	  opt3001.

endmenu
```
